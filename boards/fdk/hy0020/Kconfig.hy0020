## boards/fdk/hy0020/board.yml
```yaml
board:
  name: hy0020
  full_name: FDK HY0020
  vendor: fdk
  socs:
    - name: nrf52832
```

## boards/shields/apex_predetor/Kconfig.defconfig
```kconfig
if SHIELD_APEX_PREDETOR_DONGLE

config ZMK_KEYBOARD_NAME
    default "ApexPredetor"

config ZMK_SPLIT_ROLE_CENTRAL
    default y
    
endif

if SHIELD_APEX_PREDETOR_LEFT || SHIELD_APEX_PREDETOR_RIGHT || SHIELD_APEX_PREDETOR_DONGLE

config ZMK_SPLIT
    default y

endif
```

## boards/shields/apex_predetor/Kconfig.shield
```kconfig
config SHIELD_APEX_PREDETOR_LEFT
    def_bool $(shields_list_contains,apex_predetor_left)

config SHIELD_APEX_PREDETOR_RIGHT
    def_bool $(shields_list_contains,apex_predetor_right)

config SHIELD_APEX_PREDETOR_DONGLE
    def_bool $(shields_list_contains,apex_predetor_dongle)
```

## boards/shields/hy0020_test/Kconfig.defconfig
```kconfig
if SHIELD_HY0020_TEST || SHIELD_HY0020_TEST_PERIPHERAL

config ZMK_KEYBOARD_NAME
    default "HY0020 Test"

endif
```

## boards/shields/hy0020_test/Kconfig.shield
```kconfig
config SHIELD_HY0020_TEST
    def_bool $(shields_list_contains,hy0020_test)

config SHIELD_HY0020_TEST_PERIPHERAL
    def_bool $(shields_list_contains,hy0020_test_peripheral)
```

## dts/bindings/behaviors/zmk,behavior-ref-count-key-press.yaml
```yaml
description: Reference-counted key press behavior

compatible: "zmk,behavior-ref-count-key-press"

include: one_param.yaml
```
