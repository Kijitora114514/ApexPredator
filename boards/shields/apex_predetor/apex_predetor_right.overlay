#include "apex_predetor.dtsi"

&default_transform {
    col-offset = <6>;
};

/ {
    kscan0: kscan_right {
        compatible = "zmk,kscan-gpio-matrix";
        diode-direction = "col2row";

        row-gpios =
            <&gpio0 16 (GPIO_PULL_DOWN | GPIO_ACTIVE_HIGH)>,
            <&gpio0 18 (GPIO_PULL_DOWN | GPIO_ACTIVE_HIGH)>,
            <&gpio0 20 (GPIO_PULL_DOWN | GPIO_ACTIVE_HIGH)>,
            <&gpio0 28 (GPIO_PULL_DOWN | GPIO_ACTIVE_HIGH)>,
            <&gpio0 30 (GPIO_PULL_DOWN | GPIO_ACTIVE_HIGH)>;

        col-gpios =
            <&gpio0  2 GPIO_ACTIVE_HIGH>,
            <&gpio0  3 GPIO_ACTIVE_HIGH>,
            <&gpio0  4 GPIO_ACTIVE_HIGH>,
            <&gpio0  5 GPIO_ACTIVE_HIGH>,
            <&gpio0  6 GPIO_ACTIVE_HIGH>,
            <&gpio0  8 GPIO_ACTIVE_HIGH>,
            <&gpio0  7 GPIO_ACTIVE_HIGH>,
            <&gpio0 12 GPIO_ACTIVE_HIGH>;
    };
};
